## CMakeLists.txt
```
# Copyright (c) 2026, Altera Corporation.
# SPDX-License-Identifier: Apache-2.0

cmake_minimum_required(VERSION 3.20.0)
find_package(Zephyr REQUIRED HINTS $ENV{ZEPHYR_BASE})
project(fpga_bitstream_storage)

target_sources(app PRIVATE src/main.c)
```

## Kconfig
```
# Copyright (c) 2026, Altera Corporation.
# SPDX-License-Identifier: Apache-2.0

choice SAMPLE_FPGA_BITSTREAM_STORAGE
	prompt "Storage the bitstream is read from"
	default SAMPLE_FPGA_BITSTREAM_STORAGE_SDCARD
	help
	  Specify the type of storage the bitstream is read from.

config SAMPLE_FPGA_BITSTREAM_STORAGE_SDCARD
	bool "File on an SD card with a FAT file system"
	imply DISK_ACCESS
	imply DISK_DRIVER_SDMMC
	imply FILE_SYSTEM
	imply FAT_FILESYSTEM_ELM
	imply FS_FATFS_LFN
	help
	  Read the bitstream file from the FAT volume on the disk named SD,
	  mounted at /SD:.

config SAMPLE_FPGA_BITSTREAM_STORAGE_FLASH
	bool "MCUboot image in a flash partition"
	select FLASH
	select FLASH_MAP
	select FPGA_LOAD_IMAGE
	help
	  Read the bitstream from the flash partition with the node label
	  bitstream_partition. The partition holds an MCUboot image as
	  written by imgtool: a header with the bitstream size, followed by
	  the bitstream.

endchoice

config SAMPLE_FPGA_BITSTREAM_FILE_NAME
	string "Bitstream file name"
	default "bitstream.bin"
	depends on !SAMPLE_FPGA_BITSTREAM_STORAGE_FLASH
	help
	  Name of the bitstream file in the root directory of the volume.

config SAMPLE_FPGA_BITSTREAM_MAX_SIZE
	int "Bitstream buffer size"
	default 4194304
	help
	  Size in bytes of the buffer that holds the bitstream while it is
	  loaded. A larger bitstream is rejected.

source "Kconfig.zephyr"
```

## sample.yaml
```
sample:
  name: FPGA bitstream storage
  description: Load an FPGA bitstream read from an SD card or from flash
common:
  tags:
    - fpga
  build_only: true
tests:
  sample.drivers.fpga.bitstream_storage.sdcard:
    platform_allow:
      - intel_socfpga_agilex5_socdk
    integration_platforms:
      - intel_socfpga_agilex5_socdk
  sample.drivers.fpga.bitstream_storage.flash:
    platform_allow:
      - native_sim
      - native_sim/native/64
    integration_platforms:
      - native_sim
```

## prj.conf
```kconfig
CONFIG_FPGA=y

CONFIG_LOG=y
CONFIG_LOG_MODE_MINIMAL=y

CONFIG_MAIN_STACK_SIZE=4096
```

## boards/intel_socfpga_agilex5_socdk.conf
```kconfig
CONFIG_ALTERA_AGILEX_BRIDGE_FPGA=y
CONFIG_ARM_SIP_SVC_DRIVER=y
CONFIG_ARM_SIP_SVC_SUBSYS=y

# The FPGA driver and the SiP SVC subsystem allocate from the kernel heap
CONFIG_HEAP_MEM_POOL_SIZE=32768
```

## boards/native_sim_native_64.conf
```kconfig
CONFIG_SAMPLE_FPGA_BITSTREAM_STORAGE_FLASH=y

# The bitstream partition is 120 KiB
CONFIG_SAMPLE_FPGA_BITSTREAM_MAX_SIZE=122880
```

## boards/intel_socfpga_agilex5_socdk.overlay
```dts
/*
 * Copyright (c) 2026, Altera Corporation.
 * SPDX-License-Identifier: Apache-2.0
 */

/ {
	aliases {
		fpga0 = &fpga0;
	};
};

&sip_smc {
	status = "okay";
};
```

## boards/native_sim.overlay
```dts
/*
 * Copyright (c) 2026, Altera Corporation.
 * SPDX-License-Identifier: Apache-2.0
 */

/ {
	aliases {
		fpga0 = &fake_fpga;
	};

	fake_fpga: fake-fpga {
		compatible = "zephyr,fake-fpga";
	};
};

bitstream_partition: &scratch_partition {};
```

## boards/native_sim_native_64.overlay
```dts
/*
 * Copyright (c) 2026, Altera Corporation.
 * SPDX-License-Identifier: Apache-2.0
 */

#include "native_sim.overlay"
```

## src/main.c
```c
/*
 * Copyright (c) 2026, Altera Corporation.
 * SPDX-License-Identifier: Apache-2.0
 */

#include <errno.h>
#include <stdint.h>

#include <zephyr/device.h>
#include <zephyr/drivers/fpga.h>
#include <zephyr/kernel.h>
#include <zephyr/logging/log.h>
#include <zephyr/sys/util.h>

LOG_MODULE_REGISTER(fpga_bitstream_storage, LOG_LEVEL_INF);

/* fpga_load() takes the whole bitstream as an array of 32-bit words */
static uint32_t bitstream[DIV_ROUND_UP(CONFIG_SAMPLE_FPGA_BITSTREAM_MAX_SIZE, sizeof(uint32_t))];

#if defined(CONFIG_SAMPLE_FPGA_BITSTREAM_STORAGE_FLASH)

#include <zephyr/storage/flash_map.h>

#define BITSTREAM_SOURCE "the bitstream partition"

/* fpga_load_image() reads the bitstream behind the MCUboot image header and loads it */
static int bitstream_load(const struct device *fpga)
{
	return fpga_load_image(fpga, FIXED_PARTITION_ID(bitstream_partition), bitstream,
			       sizeof(bitstream));
}

#else /* File on the SD card */

#include <ff.h>
#include <zephyr/fs/fs.h>

#define MOUNT_POINT "/SD:"

#define BITSTREAM_SOURCE MOUNT_POINT "/" CONFIG_SAMPLE_FPGA_BITSTREAM_FILE_NAME

static FATFS fat_fs;

static struct fs_mount_t fs_mnt = {
	.type = FS_FATFS,
	.fs_data = &fat_fs,
	.mnt_point = MOUNT_POINT,
};

/* Mount the volume and list its root directory. */
static int setup_disk(void)
{
	struct fs_dirent entry;
	struct fs_dir_t dir;
	int ret;

	ret = fs_mount(&fs_mnt);
	if (ret != 0) {
		return ret;
	}

	fs_dir_t_init(&dir);

	ret = fs_opendir(&dir, MOUNT_POINT);
	if (ret != 0) {
		return ret;
	}

	LOG_INF("%s:", MOUNT_POINT);

	while (true) {
		ret = fs_readdir(&dir, &entry);
		if ((ret != 0) || (entry.name[0] == '\0')) {
			break;
		}

		LOG_INF("  %c %zu %s", (entry.type == FS_DIR_ENTRY_FILE) ? 'F' : 'D', entry.size,
			entry.name);
	}

	(void)fs_closedir(&dir);

	return ret;
}

static int bitstream_read(size_t *size)
{
	uint8_t *buf = (uint8_t *)bitstream;
	struct fs_dirent entry;
	struct fs_file_t file;
	size_t pos = 0;
	ssize_t len;
	int ret;

	ret = setup_disk();
	if (ret != 0) {
		return ret;
	}

	ret = fs_stat(BITSTREAM_SOURCE, &entry);
	if (ret != 0) {
		return ret;
	}

	if (entry.size > sizeof(bitstream)) {
		return -EFBIG;
	}

	fs_file_t_init(&file);

	ret = fs_open(&file, BITSTREAM_SOURCE, FS_O_READ);
	if (ret != 0) {
		return ret;
	}

	while (pos < entry.size) {
		len = fs_read(&file, &buf[pos], entry.size - pos);
		if (len <= 0) {
			ret = (len < 0) ? (int)len : -EIO;
			break;
		}

		pos += len;
	}

	(void)fs_close(&file);

	*size = pos;

	return ret;
}

static int bitstream_load(const struct device *fpga)
{
	size_t size;
	int ret;

	ret = bitstream_read(&size);
	if (ret != 0) {
		return ret;
	}

	LOG_INF("Read %zu bytes from %s", size, BITSTREAM_SOURCE);

	return fpga_load(fpga, bitstream, size);
}

#endif /* CONFIG_SAMPLE_FPGA_BITSTREAM_STORAGE_FLASH */

int main(void)
{
	const struct device *fpga = DEVICE_DT_GET(DT_ALIAS(fpga0));
	int ret;

	if (!device_is_ready(fpga)) {
		LOG_ERR("FPGA device %s is not ready", fpga->name);
		return 0;
	}

	ret = bitstream_load(fpga);
	if (ret != 0) {
		LOG_ERR("Failed to load the bitstream from %s (%d)", BITSTREAM_SOURCE, ret);
		return 0;
	}

	LOG_INF("Bitstream loaded, FPGA is %s",
		(fpga_get_status(fpga) == FPGA_STATUS_ACTIVE) ? "active" : "inactive");

	return 0;
}
```
