## CMakeLists.txt
```
# Copyright (c) 2026, Altera Corporation.
# SPDX-License-Identifier: Apache-2.0

cmake_minimum_required(VERSION 3.20.0)
find_package(Zephyr REQUIRED HINTS $ENV{ZEPHYR_BASE})
project(fpga_mgmt)
target_sources(app PRIVATE src/main.c)
```

## sample.yaml
```
sample:
  name: FPGA bitstream management
  description: Load an FPGA bitstream from a flash partition at boot
common:
  tags:
    - fpga
    - mgmt
  build_only: true
tests:
  sample.mgmt.fpga_mgmt:
    platform_allow:
      - intel_socfpga_agilex5_socdk
    integration_platforms:
      - intel_socfpga_agilex5_socdk
```

## prj.conf
```kconfig
# Copyright (c) 2026, Altera Corporation.
# SPDX-License-Identifier: Apache-2.0

CONFIG_LOG=y

CONFIG_FLASH=y
CONFIG_FLASH_MAP=y

CONFIG_FPGA=y
CONFIG_FPGA_MGMT=y
CONFIG_FPGA_MGMT_LOAD_ON_BOOT=y
CONFIG_FPGA_MGMT_LOG_LEVEL_DBG=y
```

## boards/intel_socfpga_agilex5_socdk.conf
```kconfig
# Copyright (c) 2026, Altera Corporation.
# SPDX-License-Identifier: Apache-2.0

CONFIG_ALTERA_AGILEX_BRIDGE_FPGA=y
CONFIG_ARM_SIP_SVC_DRIVER=y
CONFIG_ARM_SIP_SVC_SUBSYS=y

CONFIG_FPGA_LOG_LEVEL_WRN=y
CONFIG_ARM_SIP_SVC_SUBSYS_LOG_LEVEL_WRN=y
CONFIG_ARM_SIP_SVC_DRIVER_LOG_LEVEL_WRN=y

# The FPGA driver and the SiP SVC subsystem allocate from the kernel heap
CONFIG_HEAP_MEM_POOL_SIZE=32768

# The load at boot runs on the main thread: image hash and FPGA reconfiguration
CONFIG_MAIN_STACK_SIZE=8192
```

## boards/intel_socfpga_agilex5_socdk.overlay
```dts
/*
 * Copyright (c) 2026, Altera Corporation.
 * SPDX-License-Identifier: Apache-2.0
 */

/ {
	chosen {
		zephyr,fpga = &fpga0;
		/* MCUboot image at offset 0x04400000 of the QSPI flash */
		zephyr,fpga-bitstream-partition = &bitstream_partition;
	};
};

&sip_smc {
	status = "okay";
};
```

## src/main.c
```c
/*
 * Copyright (c) 2026, Altera Corporation.
 * SPDX-License-Identifier: Apache-2.0
 */

int main(void)
{
	return 0;
}
```
