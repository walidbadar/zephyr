## boards/viewe/uedx46460015_md50et/Kconfig.defconfig
```kconfig
# Copyright (c) 2024 Espressif Systems (Shanghai) Co., Ltd.
# SPDX-License-Identifier: Apache-2.0

if BOARD_UEDX46460015_MD50ET_ESP32S3_PROCPU

# Enable input subsystem for touch driver
config INPUT
	default y

if DISPLAY

config LV_COLOR_16_SWAP
	default y if LVGL

endif # DISPLAY

endif # BOARD_UEDX46460015_MD50ET_ESP32S3_PROCPU
```

## boards/viewe/uedx46460015_md50et/Kconfig.uedx46460015_md50et
```kconfig
# Copyright (c) 2024 Espressif Systems (Shanghai) Co., Ltd.
# SPDX-License-Identifier: Apache-2.0

config BOARD_UEDX46460015_MD50ET
	select SOC_ESP32S3_WROOM_N16R8
	select SOC_ESP32S3_PROCPU if BOARD_UEDX46460015_MD50ET_ESP32S3_PROCPU
	select SOC_ESP32S3_APPCPU if BOARD_UEDX46460015_MD50ET_ESP32S3_APPCPU
```

## boards/viewe/uedx46460015_md50et/board.yml
```yaml
board:
  name: uedx46460015_md50et
  full_name: VIEWE UEDX46460015_MD50ET
  vendor: viewe
  socs:
  - name: esp32s3
```

## drivers/i2c/Kconfig.bcm2711
```kconfig
# Copyright (c) 2026 Muhammad Waleed Badar
# SPDX-License-Identifier: Apache-2.0

config I2C_BCM2711
	bool "Broadcom BCM2711 I2C controller"
	default y
	depends on DT_HAS_BRCM_BCM2711_I2C_ENABLED
	help
	  Enable support for Broadcom BCM2711 I2C controller.
```

## drivers/sensor/elan/Kconfig
```kconfig
# Copyright (c) 2024 Muhammad Waleed Badar
# SPDX-License-Identifier: Apache-2.0

# zephyr-keep-sorted-start
source "drivers/sensor/elan/ekt2101/Kconfig"
# zephyr-keep-sorted-stop
```

## drivers/sensor/elan/ekt2101/Kconfig
```kconfig
# EKT2101 capacitive touchpad configuration options

# Copyright (c) 2024 Muhammad Waleed Badar
# SPDX-License-Identifier: Apache-2.0

menuconfig EKT2101
	bool "EKT2101 capacitive touchpad"
	default y
	depends on DT_HAS_ELAN_EKT2101_ENABLED
	select I2C
	help
	  Enable driver for ekt2101 I2C-based capacitive touchpad sensor.

if EKT2101

choice
	prompt "Trigger mode"
	default EKT2101_TRIGGER_GLOBAL_THREAD
	help
	  Specify the type of triggering used by the driver.

	config EKT2101_TRIGGER_GLOBAL_THREAD
		bool "Use global thread"
		depends on GPIO

	config EKT2101_TRIGGER_OWN_THREAD
		bool "Use own thread"
		depends on GPIO

endchoice

config EKT2101_THREAD_PRIORITY
	int "Thread priority"
	depends on EKT2101_TRIGGER_OWN_THREAD
	default 10
	help
	  Priority of thread used by the driver to handle interrupts.

config EKT2101_THREAD_STACK_SIZE
	int "Thread stack size"
	depends on EKT2101_TRIGGER_OWN_THREAD
	default 1024
	help
	  Stack size of thread used by the driver to handle interrupts.

endif # EKT2101
```

## dts/bindings/display/chipone,co5300-mipi-dsi.yaml
```yaml
# Copyright 2025 NXP
# Copyright (c) 2026 VIEWE Technology Co., Ltd.
# SPDX-License-Identifier: Apache-2.0

description: Chipone CO5300 display controller on MIPI DSI bus

compatible: "chipone,co5300"

include: ["mipi-dsi-device.yaml", "chipone,co5300-common.yaml"]
```

## dts/bindings/display/chipone,co5300-spi.yaml
```yaml
# Copyright (c) 2026 VIEWE Technology Co., Ltd.
# SPDX-License-Identifier: Apache-2.0

description: Chipone CO5300 display controller on SPI bus

compatible: "chipone,co5300"

include: ["spi-device.yaml", "lcd-controller.yaml", "chipone,co5300-common.yaml"]
```

## dts/bindings/i2c/brcm,bcm2711-i2c.yaml
```yaml
# Copyright (c) 2026 Muhammad Waleed Badar
# SPDX-License-Identifier: Apache-2.0

description: Broadcom BCM2711 I2C controller

compatible: "brcm,bcm2711-i2c"

include: [i2c-controller.yaml, pinctrl-device.yaml]

properties:
  reg:
    required: true

  interrupts:
    required: true

  clock-frequency:
    required: true
  
  clocks:
    required: true
```

## dts/bindings/sensor/elan,ekt2101.yaml
```yaml
# Copyright (c) 2024 Muhammad Waleed Badar
# SPDX-License-Identifier: Apache-2.0

description: eLAN EKT2101 capacitive touchpad sensor

compatible: "elan,ekt2101"

include: [sensor-device.yaml, i2c-device.yaml]

properties:
  int-gpios:
    type: phandle-array
    description: |
      The INT signal defaults to active high as produced by the
      sensor. The property value should ensure the flags properly
      describe the signal that is presented to the driver.
```
