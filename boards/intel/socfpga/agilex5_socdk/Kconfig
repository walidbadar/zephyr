## boards/intel/socfpga/agilex5_socdk/Kconfig
```kconfig
# Copyright The Zephyr Project Contributors
# SPDX-License-Identifier: Apache-2.0

if BUILD_WITH_TFA

choice AGILEX5_SOCDK_TFA_BOOT_SOURCE
	prompt "TF-A BL2 boot source"
	default AGILEX5_SOCDK_TFA_BOOT_SOURCE_QSPI
	help
	  Device from which TF-A BL2 loads the FIP containing BL31 and Zephyr.

config AGILEX5_SOCDK_TFA_BOOT_SOURCE_SDMMC
	bool "SD/MMC"

config AGILEX5_SOCDK_TFA_BOOT_SOURCE_QSPI
	bool "QSPI flash"

config AGILEX5_SOCDK_TFA_BOOT_SOURCE_NAND
	bool "NAND flash"

endchoice

endif # BUILD_WITH_TFA
```

## boards/raspberrypi/rpi_4b/Kconfig.defconfig
```kconfig
# Copyright (c) 2026 Muhammad Waleed Badar
# SPDX-License-Identifier: Apache-2.0

if BOARD_RPI_4B

if BT

choice AIROC_PART
	default CYW43438
endchoice

endif # BT

endif # BOARD_RPI_4B
```

## boards/raspberrypi/rpi_zero_2w/Kconfig.defconfig
```kconfig
# Copyright (c) 2026 Muhammad Waleed Badar
# SPDX-License-Identifier: Apache-2.0

if BOARD_RPI_ZERO_2W

config PM_DEVICE
	default y if PM

config POWER_DOMAIN
	default y if PM_DEVICE || UDC_DWC2 || UHC_DWC2

if PM_DEVICE

config PM_DEVICE_POWER_DOMAIN
	default y

endif # PM_DEVICE

endif # BOARD_RPI_ZERO_2W
```

## boards/tp-link/wr840n_v2/Kconfig.wr840n_v2
```kconfig
# Copyright (c) 2026 Muhammad Waleed Badar
# SPDX-License-Identifier: Apache-2.0

config BOARD_WR840N_V2
	select SOC_QCA9531
```

## boards/tp-link/wr840n_v2/board.yml
```yaml
board:
  name: wr840n_v2
  full_name: TP-LINK TL-WR840N v2
  vendor: tp-link
  socs:
  - name: qca9531
```

## drivers/fpga/Kconfig
```kconfig
# FPGA driver configuration options

# Copyright (c) 2021-2022 Antmicro <www.antmicro.com>
# SPDX-License-Identifier: Apache-2.0

menuconfig FPGA
	bool "Field-Programmable Gate Array (FPGA) drivers"
	help
	  Enable support for FPGA drivers.

if FPGA

module = FPGA
module-str = fpga
source "subsys/logging/Kconfig.template.log_config"

config FPGA_INIT_PRIORITY
	int "Init priority"
	default 75
	help
	  FPGA device drivers initialization priority

config FPGA_SHELL
	bool "FPGA Shell"
	depends on SHELL && FPGA
	help
	  Enable FPGA Shell support.

config FPGA_LOAD_IMAGE
	bool "Load a bitstream from an MCUboot image"
	depends on FLASH_MAP
	depends on ZEPHYR_MCUBOOT_MODULE
	help
	  Enable fpga_load_image(), which loads a bitstream stored in a flash
	  area behind an MCUboot image header. The header layout comes from
	  the MCUboot module; MCUboot itself does not have to be the
	  bootloader.

source "drivers/fpga/Kconfig.altera_agilex_bridge"
source "drivers/fpga/Kconfig.eos_s3"
source "drivers/fpga/Kconfig.fake"
source "drivers/fpga/Kconfig.ice40"
source "drivers/fpga/Kconfig.mpfs"
source "drivers/fpga/Kconfig.zynqmp"
source "drivers/fpga/Kconfig.slg471x5"

endif # FPGA
```

## drivers/fpga/Kconfig.fake
```kconfig
# Copyright (c) 2026, Altera Corporation.
# SPDX-License-Identifier: Apache-2.0

config FPGA_FAKE
	bool "Fake FPGA driver"
	default y
	depends on DT_HAS_ZEPHYR_FAKE_FPGA_ENABLED
	select CRC
	help
	  Enable the fake FPGA driver. It accepts any bitstream and logs its
	  size and CRC-32, for use on boards without an FPGA.
```

## drivers/input/Kconfig.elan
```kconfig
# Copyright (c) 2026 Muhammad Waleed Badar
# SPDX-License-Identifier: Apache-2.0

config INPUT_ELAN_EKT2101
	bool "Use ELAN EKT2101 capacitive touchpad driver"
	default y
	depends on DT_HAS_ELAN_EKT2101_ENABLED
	select I2C
	help
	  Enable driver for ELAN EKT2101 touchpad.
```

## drivers/sdhc/Kconfig.cdns
```kconfig
# Copyright (c) 2025 Advanced Micro Devices, Inc. (AMD)
# SPDX-License-Identifier: Apache-2.0

config CDNS_SDHC
	bool "xlnx sdhc driver"
	default y
	depends on DT_HAS_CDNS_SDHC_ENABLED
	select SDHC_SUPPORTS_NATIVE_MODE
	select SDHC_SUPPORTS_UHS
	select CLOCK_CONTROL
	select CLOCK_CONTROL_FIXED_RATE_CLOCK
	select CACHE_MANAGEMENT if DCACHE
	select EVENTS
	help
	  Enable DESC_SIZE SD/EMMC host controller driver

if CDNS_SDHC

config CDNS_SDHC_ADMA2_SUPPORT
	bool "ADMA2 support"
	default y
	help
	  Select ADMA2 support

config CDNS_SDHC_DESC_SIZE
	int "Max descriptor SIZE"
	default 32
	depends on CDNS_SDHC_ADMA2_SUPPORT
	help
	  Set max number of descriptors supported

# Cadence SDHC DMA buffers require cache-line alignment
config SDHC_BUFFER_ALIGNMENT
	default DCACHE_LINE_SIZE if DCACHE
	default 32

endif
```

## drivers/sensor/altera/Kconfig
```kconfig
# SPDX-FileCopyrightText: Copyright (c) 2026, Altera Corporation.
# SPDX-License-Identifier: Apache-2.0

# zephyr-keep-sorted-start
source "drivers/sensor/altera/sdm_voltage/Kconfig"
# zephyr-keep-sorted-stop
```

## drivers/sensor/altera/sdm_voltage/Kconfig
```kconfig
# SPDX-FileCopyrightText: Copyright (c) 2026, Altera Corporation.
# SPDX-License-Identifier: Apache-2.0

config ALTERA_SDM_VOLTAGE
	bool "Altera SoC FPGA SDM voltage sensor"
	default y
	depends on DT_HAS_ALTR_SOCFPGA_SDM_VOLTAGE_ENABLED
	depends on ALTERA_SDM
	help
	  Enable the driver for the voltage sensors of the Secure Device
	  Manager (SDM) of Altera SoC FPGAs, read through the SDM mailbox.
```

## drivers/spi/Kconfig.bcm283x_aux
```kconfig
# Copyright (c) 2026 Muhammad Waleed Badar
# SPDX-License-Identifier: Apache-2.0

config SPI_BCM283X_AUX
	bool "Broadcom BCM283x Auxiliary SPI controller driver"
	default y
	depends on DT_HAS_BRCM_BCM283X_AUX_SPI_ENABLED
	help
	  Enable Broadcom BCM283x Auxiliary SPI controller driver
```

## dts/bindings/cpu/mti,mips24Kc.yaml
```yaml
# Copyright (c) 2026 Muhammad Waleed Badar
# SPDX-License-Identifier: Apache-2.0

description: MIPS 24Kc

compatible: "mti,mips24Kc"

include: cpu.yaml
```

## dts/bindings/fpga/zephyr,fake-fpga.yaml
```yaml
# Copyright (c) 2026, Altera Corporation.
# SPDX-License-Identifier: Apache-2.0

description: |
  Fake FPGA for boards without an FPGA. It accepts any bitstream and logs its size and CRC-32.

compatible: "zephyr,fake-fpga"

include: base.yaml
```

## dts/bindings/input/elan,ekt2101.yaml
```yaml
description: ELAN eKT2101 Touchpad Controller

compatible: "elan,ekt2101"

include: i2c-device.yaml

properties:
  irq-gpios:
    type: phandle-array
    required: true
    description: |
      Interrupt GPIO. Used by the controller to signal touch data is available. Active low.

  polling-interval-ms:
    type: int
    default: 50
    min: 20
    description: |
      Interval between two reads, in ms. The interval must be greater than 20 ms or equal to 0 ms.
      Defaults to 50 ms.
```

## dts/bindings/sdhc/cdns,sdhc.yaml
```yaml
# Copyright (c) 2023 Intel Corporation
# SPDX-License-Identifier: Apache-2.0

description: Cadence SD Host controller

compatible: "cdns,sdhc"

include: [sdhc.yaml]

properties:
  reg:
    required: true

  clocks:
    required: true

  broken-cd:
    type: boolean
    description:
      There is no card detection available; polling must be used.
```

## dts/bindings/sensor/altr,socfpga-sdm-voltage.yaml
```yaml
# SPDX-FileCopyrightText: Copyright (c) 2026, Altera Corporation.
# SPDX-License-Identifier: Apache-2.0

description: |
  Voltage sensor of the Secure Device Manager (SDM) of Altera SoC FPGAs.

  The voltage is read with the SDM mailbox GET_VOLTAGE command. The sensor
  has no interface of its own, so it is modelled as a child of the
  altr,socfpga-sdm node. Each node describes one SDM voltage channel and is
  exposed as SENSOR_CHAN_VOLTAGE.

  Example:

    &sdm {
            status = "okay";

            vcc: voltage-2 {
                    compatible = "altr,socfpga-sdm-voltage";
                    channel = <2>;
            };
    };

compatible: "altr,socfpga-sdm-voltage"

include: sensor-device.yaml

properties:
  channel:
    type: int
    required: true
    description: |
      SDM voltage channel number, 0 to 15. The channel to rail mapping is
      device specific; see the SDM mailbox documentation of the SoC.
```

## dts/bindings/spi/brcm,bcm283x-aux-spi.yaml
```yaml
description: Broadcom BCM283x Auxiliary SPI Controller

compatible: "brcm,bcm283x-aux-spi"

include: [spi-controller.yaml, pinctrl-device.yaml]

properties:
  reg:
    required: true

  clocks:
    required: true
```

## dts/bindings/video/zephyr,native-sim-video-fifo.yaml
```yaml
# Copyright The Zephyr Project Contributors
# SPDX-License-Identifier: Apache-2.0

description: |
  Native simulator video source reading raw frames from a host named pipe
  (FIFO), or capturing them from a host V4L2 device.

  The application selects the frame format through the video API. A FIFO
  writer must produce frames of exactly that format, and a V4L2 device must
  provide it as is, except RGB565, which is converted on the host from YUYV
  when the device does not provide it.

  See the native_sim board documentation for how to feed the FIFO and for the
  details of the driver behaviour.

compatible: "zephyr,native-sim-video-fifo"

include: base.yaml

properties:
  fifo-path:
    type: string
    description: |
      Path of the host named pipe to read the frames from, or of a V4L2
      capture device such as /dev/video0. A FIFO is created if the path does
      not exist yet. Defaults to /tmp/zephyr-<device>-<pid>.fifo. It can be
      overridden at runtime with the --<device>=<path> command line option.

  poll-interval-ms:
    type: int
    default: 10
    description: |
      Delay before reading the host source again when it did not provide a
      complete frame: no FIFO writer is attached, the writer is slower than
      the driver, or the V4L2 device has no frame ready yet. This does not
      limit the frame rate: the driver reads again immediately after a frame
      is completed.
```

## soc/qca/qca9531/Kconfig
```kconfig
# Copyright (c) 2026 Muhammad Waleed Badar
# SPDX-License-Identifier: Apache-2.0

config SOC_QCA9531
	select MIPS
	select MIPS_CP0_TIMER
	select BIG_ENDIAN
```

## soc/qca/qca9531/Kconfig.defconfig
```kconfig
# Copyright (c) 2026 Muhammad Waleed Badar
# SPDX-License-Identifier: Apache-2.0

if SOC_QCA9531

config NUM_IRQS
	default 32

config SYS_CLOCK_HW_CYCLES_PER_SEC
	default $(dt_node_int_prop_int,/cpus/cpu@0,clock-frequency)

configdefault UART_NS16550_ACCESS_WORD_ONLY
	default y

endif # SOC_QCA9531
```

## soc/qca/qca9531/Kconfig.soc
```kconfig
# Copyright (c) 2026 Muhammad Waleed Badar
# SPDX-License-Identifier: Apache-2.0

config SOC_QCA9531
	bool

config SOC
	default "qca9531" if SOC_QCA9531
```
