/*
 * Copyright (c) 2026 Muhammad Waleed Badar
 *
 * SPDX-License-Identifier: Apache-2.0
 */

/dts-v1/;

#include <qca/qca9531.dtsi>

/ {
	model = "TP-LINK TL-WR840N v2";
	compatible = "tp-link,wr840n-v2", "qca,qca9531";

	chosen {
		zephyr,console = &uart0;
		zephyr,shell-uart = &uart0;
		zephyr,sram = &dram0;
	};

	dram0: memory@80000000 {
		device_type = "memory";
		reg = <0x80000000 DT_SIZE_M(32)>;
	};
};

&uart0 {
	status = "okay";
	current-speed = <115200>;
};
