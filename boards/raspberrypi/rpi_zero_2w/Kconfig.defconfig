## boards/raspberrypi/rpi_zero_2w/Kconfig.defconfig
```kconfig
# Copyright (c) 2026 Muhammad Waleed Badar
# SPDX-License-Identifier: Apache-2.0

if BOARD_RPI_ZERO_2W

config PM_DEVICE
	default y if UDC_DWC2 || UHC_DWC2

if PM_DEVICE

config POWER_DOMAIN
	default y

config PM_DEVICE_POWER_DOMAIN
	default y

endif # PM_DEVICE

endif # BOARD_RPI_ZERO_2W
```

## drivers/fpga/Kconfig
```kconfig
# FPGA driver configuration options

# Copyright (c) 2021-2022 Antmicro <www.antmicro.com>
# SPDX-License-Identifier: Apache-2.0

menuconfig FPGA
	bool "Field-Programmable Gate Array (FPGA) drivers"
	help
	  Enable support for FPGA drivers.

if FPGA

module = FPGA
module-str = fpga
source "subsys/logging/Kconfig.template.log_config"

config FPGA_INIT_PRIORITY
	int "Init priority"
	default 75
	help
	  FPGA device drivers initialization priority

config FPGA_SHELL
	bool "FPGA Shell"
	depends on SHELL && FPGA
	help
	  Enable FPGA Shell support.

config FPGA_LOAD_CHUNKED
	bool
	help
	  Selected by drivers whose fpga_load() also accepts a bitstream in
	  chunks of FPGA_LOAD_CHUNK_SIZE bytes.

config FPGA_LOAD_CHUNK_SIZE
	int "Bitstream chunk size"
	default 65536
	range 4096 16777216
	depends on FPGA_LOAD_CHUNKED
	help
	  Size in bytes of the chunks a bitstream can be passed in, so that
	  it does not have to be held in memory as a whole. A fpga_load()
	  call with exactly this many bytes starts or continues a bitstream
	  and is followed by further calls; a call with fewer bytes, which
	  can be zero, ends it. A single call with any other size is a whole
	  bitstream. Must be a multiple of 4.

source "drivers/fpga/Kconfig.altera_agilex_bridge"
source "drivers/fpga/Kconfig.eos_s3"
source "drivers/fpga/Kconfig.fake"
source "drivers/fpga/Kconfig.ice40"
source "drivers/fpga/Kconfig.mpfs"
source "drivers/fpga/Kconfig.zynqmp"
source "drivers/fpga/Kconfig.slg471x5"

endif # FPGA
```

## drivers/mspi/Kconfig.esp32
```kconfig
# Copyright 2026 Pavel Maloletkov
# SPDX-License-Identifier: Apache-2.0

config MSPI_ESP32
	bool "ESP32 MSPI driver"
	default y
	depends on DT_HAS_ESPRESSIF_ESP32_MSPI_ENABLED
	select PINCTRL
	select GPIO if $(dt_compat_any_has_prop,$(DT_COMPAT_ESPRESSIF_ESP32_MSPI),ce-gpios)
	select MSPI_DMA if $(dt_compat_any_has_prop,$(DT_COMPAT_ESPRESSIF_ESP32_MSPI),dma-enabled,True)
	help
	  Driver for the ESP32 general purpose SPI peripherals through the
	  MSPI API.

if MSPI_ESP32

config MSPI_ESP32_DMA_MAX_BUFFER_SIZE
	int "Longest DMA transaction (bytes)"
	default 4092
	range 64 4092
	help
	  Longest data phase the driver hands to the DMA in one transaction.
	  Longer packets are split into pieces with CS held between them.

config MSPI_ESP32_INTERRUPT
	bool "ESP32 MSPI interrupt mode"
	default y if $(dt_compat_any_has_prop,$(DT_COMPAT_ESPRESSIF_ESP32_MSPI),interrupts)
	help
	  Wait for the transaction done interrupt instead of polling, so that
	  other threads run while a transfer is in flight. Needs an interrupts
	  property on the controller node.

config MSPI_ESP32_PSRAM_DMA
	bool "Transfer directly out of PSRAM buffers"
	# SoCs whose GDMA can address PSRAM (SOC_PSRAM_DMA_CAPABLE)
	depends on ESP_SPIRAM && (SOC_SERIES_ESP32S3 || SOC_SERIES_ESP32P4 || \
		SOC_SERIES_ESP32C5 || SOC_SERIES_ESP32C61)
	help
	  Hand cache-line aligned PSRAM buffers to the DMA instead of copying
	  them into internal RAM first. PSRAM bandwidth is shared with
	  instruction fetch; when it cannot keep up with the bus clock the FIFO
	  underruns and the data is silently corrupted. Enable only at a bus
	  clock PSRAM sustains and verify the data.

endif # MSPI_ESP32
```

## dts/bindings/mspi/espressif,esp32-mspi.yaml
```yaml
# espressif,esp32-mspi.yaml
# Copyright (c) 2026, Pavel Maloletkov
# SPDX-License-Identifier: Apache-2.0

title: Espressif ESP32 GP-SPI (General Purpose Serial Peripheral Interface) controller

description: |
  SPI2 and SPI3 peripherals of the ESP32 family, used through the MSPI API.

compatible: "espressif,esp32-mspi"

include: [mspi-controller.yaml, pinctrl-device.yaml]

properties:
  pinctrl-0:
    required: true

  pinctrl-names:
    required: true

  reg:
    required: true

  peripheral-id:
    type: int
    required: true
    description: |
      SPI peripheral index: 0 for SPI2, 1 for SPI3. SPI0 and SPI1 are reserved
      for the flash cache.

  clocks:
    required: true

  clock-frequency:
    type: int
    default: 80000000
    description: Maximum bus clock in Hz.

  dma-enabled:
    type: boolean
    description: Use DMA for data transfers.

  dmas:
    type: phandle-array
    description: |
      GDMA channels for TX and RX. Required with dma-enabled on SoCs with a
      GDMA controller (ESP32-S3, ESP32-C3, ESP32-C6, ESP32-P4, ...).

  dma-names:
    type: string-array
    description: Names of the dmas entries, "tx" and "rx".

  dma-host:
    type: int
    description: DMA peripheral slot, 0 for SPI2 and 1 for SPI3.

  dma-clk:
    type: int
    description: |
      Clock module ID of the integrated SPI DMA engine. Only on ESP32 and
      ESP32-S2, which have no GDMA controller.

  line-idle-low:
    type: boolean
    description: Drive the data lines low when idle instead of high.

  use-iomux:
    type: boolean
    description: |
      Route the signals through IO_MUX instead of the GPIO matrix. Needed above
      20 MHz; only the dedicated IO_MUX pins of the peripheral can be used.

  transfer-timeout-ms:
    type: int
    default: 100
    description: Transfer timeout in milliseconds for transfers that set none.

  duty-cycle:
    type: int
    default: 128
    description: Clock duty cycle, 0 to 255 with 128 for 50 %.
```

## subsys/mgmt/fpga_mgmt/Kconfig
```kconfig
# Copyright (c) 2026, Altera Corporation.
# SPDX-License-Identifier: Apache-2.0

DT_CHOSEN_Z_FPGA := zephyr,fpga

menuconfig FPGA_MGMT
	bool "FPGA bitstream management"
	depends on FPGA
	depends on FPGA_LOAD_CHUNKED
	depends on $(dt_chosen_enabled,$(DT_CHOSEN_Z_FPGA))
	help
	  Load FPGA bitstreams from storage into the device of the zephyr,fpga
	  chosen node, from the application or at boot.
	  The storage backends read the bitstream through a buffer of
	  FPGA_LOAD_CHUNK_SIZE bytes and pass it to the driver in chunks with
	  fpga_load(), so the FPGA driver must accept chunked bitstreams.

if FPGA_MGMT

rsource "Kconfig.flash"
rsource "Kconfig.fs"

config FPGA_MGMT_LOAD_ON_BOOT
	bool "Load the FPGA bitstream at boot"
	depends on FPGA_MGMT_BACKEND_FLASH_BOOT_PARTITION || FPGA_MGMT_BACKEND_FS
	help
	  Load a bitstream from one storage backend during system
	  initialization. If the load fails, an error is logged and the
	  system boots with the FPGA left as it was.

choice FPGA_MGMT_LOAD_ON_BOOT_BACKEND
	prompt "Backend the bitstream is loaded from at boot"
	default FPGA_MGMT_LOAD_ON_BOOT_FLASH
	depends on FPGA_MGMT_LOAD_ON_BOOT
	help
	  The bitstream is loaded at boot from one backend. Select it here
	  when both backends are enabled; the flash partition is the
	  default.

config FPGA_MGMT_LOAD_ON_BOOT_FLASH
	bool "Flash partition"
	depends on FPGA_MGMT_BACKEND_FLASH_BOOT_PARTITION
	help
	  Load the image in the partition of the
	  zephyr,fpga-bitstream-partition chosen node.

config FPGA_MGMT_LOAD_ON_BOOT_FS
	bool "File system"
	depends on FPGA_MGMT_BACKEND_FS
	help
	  Load the file FPGA_MGMT_BACKEND_FS_BOOT_FILE.

endchoice

config FPGA_MGMT_LOAD_ON_BOOT_PRIORITY
	int "Init priority of the load at boot"
	default APPLICATION_INIT_PRIORITY
	depends on FPGA_MGMT_LOAD_ON_BOOT
	help
	  Priority, in the APPLICATION init level, at which the bitstream is
	  loaded.

module = FPGA_MGMT
module-str = fpga_mgmt
source "subsys/logging/Kconfig.template.log_config"

endif # FPGA_MGMT
```

## subsys/mgmt/fpga_mgmt/Kconfig.flash
```kconfig
# Copyright (c) 2026, Altera Corporation.
# SPDX-License-Identifier: Apache-2.0

DT_CHOSEN_Z_FPGA_BITSTREAM_PARTITION := zephyr,fpga-bitstream-partition

config FPGA_MGMT_BACKEND_FLASH
	bool "Flash partition backend"
	default y
	depends on FLASH_MAP
	depends on ZEPHYR_MCUBOOT_MODULE
	help
	  Enable FPGA_MGMT_BACKEND_FLASH, which loads a bitstream stored in a
	  flash partition as an MCUboot image, as written by imgtool, so the
	  partition needs no file system to record the bitstream size. The
	  image can be written with any tool, for example uploaded with the
	  MCUmgr image management group. Only the image header layout comes
	  from the MCUboot module; MCUboot itself does not have to be the
	  bootloader.

if FPGA_MGMT_BACKEND_FLASH

config FPGA_MGMT_BACKEND_FLASH_VERIFY_SHA256
	bool "Verify the SHA-256 hash of FPGA images"
	default y
	select PSA_CRYPTO
	select PSA_WANT_ALG_SHA_256
	help
	  Check the SHA-256 hash TLV of the image before the bitstream is
	  passed to the driver. This detects corrupted or partially written
	  images. Image signatures are not verified.

config FPGA_MGMT_BACKEND_FLASH_HASH_BUF_SIZE
	int "FPGA image hash read size"
	default 4096
	depends on FPGA_MGMT_BACKEND_FLASH_VERIFY_SHA256
	help
	  Size in bytes of the static buffer the image is read from flash
	  through to hash it.

config FPGA_MGMT_BACKEND_FLASH_BOOT_PARTITION
	def_bool $(dt_chosen_enabled,$(DT_CHOSEN_Z_FPGA_BITSTREAM_PARTITION))
	help
	  The zephyr,fpga-bitstream-partition chosen node names the partition
	  that FPGA_MGMT_LOAD_ON_BOOT loads.

endif # FPGA_MGMT_BACKEND_FLASH
```
